// Native fitter for the TPOINT cross-check. Not a Unity suite.
//
//   fit      one-shot fitRigidModel of catalog sky against TPOINT dial axes
//   session  firmware path: first-star sync, fitProgressive for goto only
//            (stored stars stay in the accept encoder frame), then close
//   instrsky sky HA/Dec for instrument axes under a given T + head
//   walgoto  sky RA/Dec that parks encoders on Wallace dials under T + head
//   gridrms  like fit (Wallace dials), then true RMS on N Alt/Az points
//   self     stars generated by HeadGeom, then fitted, to show the fitter
//            inverts its own model
//   selfgrid like self, then true RMS on N Alt/Az points (HeadGeom truth)
//   plumbedgrid  ME/MA as plumbed pole tilts + HeadGeom CH/NP/ID; fit + grid
//   plumbedgoto  sky RA/Dec that parks encoders on those plumbed dials
//   dials    HeadGeom encoder dials (hour angle, dec) for an injected model
//   raw      RA/Dec/LST/:GXP observations from a live mount
//   twostar  exact two-star close-out from :GXAo lines (Taki + minimize*)
//   stored   N>=3 :GXAo replay: batch close-out and progressive+shift session
//
// Sky coordinates fed to CoordConv are direct_Az_S and altitude, the pair
// the firmware records. Axis angles are the encoder readings.

#include <cmath>
#include <cstdio>
#include <cstring>
#include <vector>

#include "TeenAstroLA3.cpp"
#include "TeenAstroCoord_EQ.cpp"
#include "TeenAstroCoord_HO.cpp"
#include "TeenAstroCoord_IN.cpp"
#include "TeenAstroCoord_LO.cpp"
#include "TeenAstroCoordConv.cpp"

static const double DEG = M_PI / 180.0;
static const double ARCSEC = M_PI / (180.0 * 3600.0);
static const LA3::RefrOpt NO_REFR = { false, 10.0, 1010.0 };

struct StarIn {
  double ha, dec;       // true sky, radians
  double dha, ddec;     // declared catalog, radians (centering noise lives here)
  double mha, mdec;     // TPOINT mount dials, radians
  bool flip;
};

static void eqToSky(double ha, double dec, double lat, double &azS, double &alt)
{
  Coord_EQ eq(0.0, dec, ha);
  Coord_HO ho = eq.To_Coord_HO(lat, NO_REFR);
  azS = ho.direct_Az_S();
  alt = ho.Alt();
}

static void skyToEq(double azS, double alt, double lat, double &ha, double &dec)
{
  // Coord_HO stores the Z euler as modRad(-Az + pi), and direct_Az_S returns it.
  // Passing Az = pi - azS recovers that euler.
  Coord_HO ho(0.0, alt, M_PI - azS, false);
  Coord_EQ eq = ho.To_Coord_EQ(lat);
  ha = eq.Ha();
  dec = eq.Dec();
}

static void axesOf(const double (&Tm)[3][3], const HeadModel &head,
                   double azS, double alt, bool flip, double &a1, double &a2)
{
  double dcSky[3], dcIn[3];
  LA3::toDirCos(dcSky, azS, alt);
  LA3::multiply(dcIn, Tm, dcSky);
  LA3::normalize(dcIn, dcIn);
  const double s = asin(dcIn[2] > 1.0 ? 1.0 : (dcIn[2] < -1.0 ? -1.0 : dcIn[2]));
  HeadGeom::inverse(dcIn, head, flip ? (M_PI - s) : s, a1, a2);
}

static void dialsOf(const double (&Tinv)[3][3], double a1, double a2, double lat,
                    double &ha, double &dec)
{
  double dcIn[3], sky[3];
  HeadGeom::forward(dcIn, a1, a2, HeadModel());
  LA3::multiply(sky, Tinv, dcIn);
  LA3::normalize(sky, sky);
  const double alt = asin(sky[2] > 1.0 ? 1.0 : (sky[2] < -1.0 ? -1.0 : sky[2]));
  const double azS = atan2(-sky[1], sky[0]);
  skyToEq(azS, alt, lat, ha, dec);
}

// Hour angle and declination are the instrument angles. HeadGeom matches
// Wallace's CH, NP and ID in this frame (the same frame as the OnStep
// agreement tests). Pushing the dials through altitude and azimuth first
// turns those terms into a different function, so the fitter cannot recover them.
static void equatorialAxes(double ha, double dec, bool flip, const HeadModel &head,
                           double &a1, double &a2)
{
  double dc[3];
  LA3::toDirCos(dc, -ha, dec);
  const double hint = flip ? (M_PI - dec) : dec;
  if (!HeadGeom::inverse(dc, head, hint, a1, a2)) {
    a1 = -ha;
    a2 = flip ? (M_PI - dec) : dec;
  }
}

static void equatorialDials(double a1, double a2, double &ha, double &dec)
{
  double dc[3];
  HeadGeom::forward(dc, a1, a2, HeadModel());
  dec = asin(dc[2] > 1.0 ? 1.0 : (dc[2] < -1.0 ? -1.0 : dc[2]));
  ha = atan2(dc[1], dc[0]);
}

static void coldMount(double lat, double (&Tm)[3][3], double (&Tinv)[3][3])
{
  CoordConv cc;
  cc.setPoleError(lat, 0.0, 0.0, 0.0);
  LA3::copy(Tm, cc.T);
  LA3::copy(Tinv, cc.Tinv);
}

static void feed(CoordConv &cc, double azS, double alt, double a1, double a2)
{
  const bool seed = cc.getStars() < 2;
  cc.addStar(azS, alt, a1, a2);
  if (seed)
    cc.addReference(azS, alt, a1, a2);
}

static void residual(const CoordConv &cc, double azS, double alt, double a1, double a2,
                     double &sep, double &ew, double &ns)
{
  double dcIn[3], sky[3], target[3];
  HeadGeom::forward(dcIn, a1, a2, cc.head);
  LA3::multiply(sky, cc.Tinv, dcIn);
  LA3::normalize(sky, sky);
  LA3::toDirCos(target, azS, alt);
  sep = LA3::angle2Vectors(sky, target);
  const double altM = asin(sky[2] > 1.0 ? 1.0 : (sky[2] < -1.0 ? -1.0 : sky[2]));
  const double azM = atan2(-sky[1], sky[0]);
  double dAz = azM - azS;
  while (dAz > M_PI) dAz -= 2.0 * M_PI;
  while (dAz < -M_PI) dAz += 2.0 * M_PI;
  ew = dAz * cos(alt);
  ns = altM - alt;
}

static void printFit(const CoordConv &cc, double lat, const std::vector<StarIn> &stars,
                     const std::vector<double> &a1, const std::vector<double> &a2)
{
  float cone, perp, idx;
  cc.getHead(cone, perp, idx);
  std::printf("ok 1\n");
  std::printf("mask %u\n", (unsigned)cc.getRigidMask());
  std::printf("pole %.8f\n", cc.polErrorDeg(lat, PE_POL_W));
  std::printf("pole_az %.8f\n", cc.polErrorDeg(lat, PE_EQ_AZ));
  std::printf("pole_alt %.8f\n", cc.polErrorDeg(lat, PE_EQ_ALT));
  // Pole of the instrument z axis in the equatorial frame the fit uses.
  // polErrorDeg assumes a horizontal embedding and is not this angle.
  {
    const double px = cc.Tinv[0][2];
    const double py = cc.Tinv[1][2];
    const double pz = cc.Tinv[2][2];
    std::printf("eq_el %.8f\n", atan2(px, pz) / DEG);
    std::printf("eq_az %.8f\n", atan2(py, pz) / DEG);
  }
  std::printf("cone %.6f\n", cone / ARCSEC);
  std::printf("perp %.6f\n", perp / ARCSEC);
  std::printf("idx2 %.6f\n", idx / ARCSEC);
  std::printf("rms %.6f\n", cc.getRigidRms() / ARCSEC);
  std::printf("residuals %u\n", (unsigned)stars.size());
  for (size_t i = 0; i < stars.size(); i++) {
    double sep, ew, ns;
    residual(cc, -stars[i].dha, stars[i].ddec, a1[i], a2[i], sep, ew, ns);
    std::printf("%.4f %.4f %.4f\n", ew / ARCSEC, ns / ARCSEC, sep / ARCSEC);
  }
}

static bool readStars(int n, bool withMount, std::vector<StarIn> &stars)
{
  for (int i = 0; i < n; i++) {
    StarIn s;
    double ha, dec, dha, ddec, mha, mdec;
    int flip = 0;
    if (withMount) {
      if (std::scanf("%lf %lf %lf %lf %lf %lf %d",
                     &ha, &dec, &dha, &ddec, &mha, &mdec, &flip) != 7)
        return false;
      s.mha = mha * DEG;
      s.mdec = mdec * DEG;
    } else {
      if (std::scanf("%lf %lf %d", &ha, &dec, &flip) != 3)
        return false;
      s.mha = ha * DEG;
      s.mdec = dec * DEG;
      dha = ha;
      ddec = dec;
    }
    s.ha = ha * DEG;
    s.dec = dec * DEG;
    s.dha = dha * DEG;
    s.ddec = ddec * DEG;
    s.flip = flip != 0;
    stars.push_back(s);
  }
  return true;
}

static int cmdFit(double lat)
{
  int n = 0;
  if (std::scanf("%d", &n) != 1 || n < 4 || n > 9)
    return 1;
  std::vector<StarIn> stars;
  if (!readStars(n, true, stars))
    return 1;

  HeadModel zero;
  CoordConv cc;
  std::vector<double> a1(n), a2(n);
  for (int i = 0; i < n; i++) {
    equatorialAxes(stars[i].mha, stars[i].mdec, stars[i].flip, zero, a1[i], a2[i]);
    // Sky and axes share the equatorial frame, so a pure latitude rotation
    // is not mistaken for a pole error.
    feed(cc, -stars[i].dha, stars[i].ddec, a1[i], a2[i]);
  }
  if (!cc.fitRigidModel()) {
    std::printf("ok 0\n");
    return 0;
  }
  printFit(cc, lat, stars, a1, a2);
  return 0;
}

// Wallace mount dials (radians) for a true HA/Dec, matching tpoint_eq.mount_for_true.
static void wallaceDials(double tha, double tdec, double side,
                         double me, double ma, double ch, double np, double id,
                         double &mha, double &mdec)
{
  mha = tha;
  mdec = tdec;
  for (int round = 0; round < 16; round++) {
    const double sec = 1.0 / cos(mdec);
    const double tn = tan(mdec);
    const double dh = (ch * side) * sec + (np * side) * tn
                    + ma * cos(mha) * tn - me * sin(mha) * tn;
    const double dd = (id * side) - me * cos(mha) + ma * sin(mha);
    mha = tha - dh;
    mdec = tdec - dd;
  }
}

// True pointing RMS: N equal-area Alt/Az samples above minAlt. For each point,
// Wallace truth makes the dials; the fitted HeadGeom+T maps those dials back
// to sky; residual is the great-circle miss. Fit-star RMS alone can look good
// while the model is wrong off the star set.
static int cmdGridRms(double lat)
{
  int nGrid = 0, n = 0;
  double minAltDeg = 15.0, maxAltDeg = 85.0;
  double meAm = 0, maAm = 0, chAm = 0, npAm = 0, idAm = 0;
  if (std::scanf("%d %lf %lf", &nGrid, &minAltDeg, &maxAltDeg) != 3
      || nGrid < 10 || nGrid > 20000)
    return 1;
  if (std::scanf("%lf %lf %lf %lf %lf", &meAm, &maAm, &chAm, &npAm, &idAm) != 5)
    return 1;
  if (std::scanf("%d", &n) != 1 || n < 4 || n > 9)
    return 1;
  std::vector<StarIn> stars;
  if (!readStars(n, true, stars))
    return 1;

  HeadModel zero;
  CoordConv cc;
  std::vector<double> a1(n), a2(n);
  for (int i = 0; i < n; i++) {
    equatorialAxes(stars[i].mha, stars[i].mdec, stars[i].flip, zero, a1[i], a2[i]);
    feed(cc, -stars[i].dha, stars[i].ddec, a1[i], a2[i]);
  }
  if (!cc.fitRigidModel()) {
    std::printf("ok 0\n");
    return 0;
  }
  printFit(cc, lat, stars, a1, a2);

  const double me = meAm * 60.0 * ARCSEC;
  const double ma = maAm * 60.0 * ARCSEC;
  const double ch = chAm * 60.0 * ARCSEC;
  const double np = npAm * 60.0 * ARCSEC;
  const double id = idAm * 60.0 * ARCSEC;
  const double z0 = sin(minAltDeg * DEG);
  const double z1 = sin(maxAltDeg * DEG);
  const double golden = M_PI * (3.0 - sqrt(5.0));

  double sumSq = 0.0, worst = 0.0;
  int used = 0;
  for (int i = 0; i < nGrid; i++) {
    const double z = z0 + (z1 - z0) * ((i + 0.5) / nGrid);
    const double alt = asin(z > 1.0 ? 1.0 : (z < -1.0 ? -1.0 : z));
    const double az = fmod((i * golden), 2.0 * M_PI);
    // Coord_HO Az north-based; constructor takes Az, stores euler as modRad(-Az+pi).
    Coord_HO ho(0.0, alt, az, false);
    Coord_EQ eq = ho.To_Coord_EQ(lat);
    const double tha = eq.Ha();
    const double tdec = eq.Dec();
    if (fabs(tdec) > 80.0 * DEG)
      continue;
    const bool flip = tha < 0.0; // west of meridian → pier west convention here
    const double side = flip ? -1.0 : 1.0;
    double mha, mdec;
    wallaceDials(tha, tdec, side, me, ma, ch, np, id, mha, mdec);
    if (fabs(mdec) > 89.0 * DEG)
      continue;
    double ax1, ax2;
    equatorialAxes(mha, mdec, flip, zero, ax1, ax2);
    double sep, ew, ns;
    residual(cc, -tha, tdec, ax1, ax2, sep, ew, ns);
    if (!(sep >= 0.0) || sep != sep)
      continue;
    sumSq += sep * sep;
    if (sep > worst)
      worst = sep;
    used++;
  }
  const double rms = used > 0 ? sqrt(sumSq / used) : 0.0;
  std::printf("grid_n %d\n", used);
  std::printf("grid_rms %.6f\n", rms / ARCSEC);
  std::printf("grid_max %.6f\n", worst / ARCSEC);
  return 0;
}

static int cmdSession(double lat)
{
  double home1 = 0, home2 = 0;
  int n = 0;
  if (std::scanf("%lf %lf %d", &home1, &home2, &n) != 3 || n < 4 || n > 9)
    return 1;
  home1 *= DEG;
  home2 *= DEG;
  std::vector<StarIn> stars;
  if (!readStars(n, true, stars))
    return 1;

  HeadModel zero;

  std::vector<double> true1(n), true2(n), ideal1(n), ideal2(n);
  std::vector<double> daz(n), dalt(n);
  for (int i = 0; i < n; i++) {
    daz[i] = -stars[i].dha;
    dalt[i] = stars[i].ddec;
    equatorialAxes(stars[i].mha, stars[i].mdec, stars[i].flip, zero, true1[i], true2[i]);
    equatorialAxes(stars[i].dha, stars[i].ddec, stars[i].flip, zero, ideal1[i], ideal2[i]);
  }

  CoordConv cc;
  cc.setPoleError(lat, 0.0, 0.0, 0.0);
  double anchorM1 = 0, anchorM2 = 0, anchorT1 = 0, anchorT2 = 0;
  std::vector<double> rec1(n), rec2(n);

  std::printf("steps %d\n", n);
  for (int k = 0; k < n; k++) {
    double arr1, arr2;
    if (k == 0) {
      arr1 = ideal1[0] + home1;
      arr2 = ideal2[0] + home2;
    } else {
      double m1, m2;
      if (cc.getRefs() >= 2)
        axesOf(cc.T, cc.head, daz[k], dalt[k], stars[k].flip, m1, m2);
      else
        equatorialAxes(stars[k].dha, stars[k].ddec, stars[k].flip, zero, m1, m2);
      arr1 = anchorT1 + (m1 - anchorM1);
      arr2 = anchorT2 + (m2 - anchorM2);
    }
    double arrHa, arrDec;
    equatorialDials(arr1, arr2, arrHa, arrDec);

    if (k == 0) {
      rec1[0] = ideal1[0];
      rec2[0] = ideal2[0];
      anchorM1 = rec1[0];
      anchorM2 = rec2[0];
      anchorT1 = true1[0];
      anchorT2 = true2[0];
    } else {
      rec1[k] = anchorM1 + (true1[k] - anchorT1);
      rec2[k] = anchorM2 + (true2[k] - anchorT2);
    }
    feed(cc, daz[k], dalt[k], rec1[k], rec2[k]);

    unsigned mask = 0;
    double rms = 0;
    double cone = 0;
    if (k >= 2 && k < n - 1 && cc.fitProgressive(&rms)) {
      float c, p, ix;
      cc.getHead(c, p, ix);
      cone = c / ARCSEC;
      mask = cc.getRigidMask();
      // Match firmware: progressive updates T/head for the next arrival
      // prediction only. Stored axes stay in the accept encoder frame.
      double n1, n2;
      axesOf(cc.T, cc.head, daz[k], dalt[k], stars[k].flip, n1, n2);
      anchorM1 = n1;
      anchorM2 = n2;
      anchorT1 = true1[k];
      anchorT2 = true2[k];
      rms = rms / ARCSEC;
    }
    std::printf("%d %u %.4f %.4f %.8f %.8f\n",
                k + 1, mask, rms, cone, arrHa / DEG, arrDec / DEG);
  }

  if (!cc.fitRigidModel()) {
    std::printf("ok 0\n");
    return 0;
  }
  printFit(cc, lat, stars, rec1, rec2);
  return 0;
}

static int cmdSelf(double lat)
{
  double dAz, dAlt, coneAs, perpAs, idxAs;
  int n = 0;
  if (std::scanf("%lf %lf %lf %lf %lf %d", &dAz, &dAlt, &coneAs, &perpAs, &idxAs, &n) != 6
      || n < 4 || n > 9)
    return 1;
  std::vector<StarIn> stars;
  if (!readStars(n, false, stars))
    return 1;

  CoordConv built;
  built.setPoleError(lat, dAz * DEG, dAlt * DEG, 0.0);
  HeadModel head(coneAs * ARCSEC, perpAs * ARCSEC, idxAs * ARCSEC);
  CoordConv cc;
  std::vector<double> a1(n), a2(n);
  for (int i = 0; i < n; i++) {
    double azS, alt;
    eqToSky(stars[i].ha, stars[i].dec, lat, azS, alt);
    axesOf(built.T, head, azS, alt, stars[i].flip, a1[i], a2[i]);
    // Declared sky is the true sky: the fitter is inverting its own model.
    stars[i].dha = stars[i].ha;
    stars[i].ddec = stars[i].dec;
    feed(cc, azS, alt, a1[i], a2[i]);
  }
  if (!cc.fitRigidModel()) {
    std::printf("ok 0\n");
    return 0;
  }
  printFit(cc, lat, stars, a1, a2);
  return 0;
}

// HeadGeom native: inject with setPoleError+head, fit, then true RMS on an
// equal-area Alt/Az grid whose dials come from the same HeadGeom truth.
static int cmdSelfGrid(double lat)
{
  int nGrid = 0, n = 0;
  double minAltDeg = 15.0, maxAltDeg = 85.0;
  double dAz, dAlt, coneAs, perpAs, idxAs;
  if (std::scanf("%d %lf %lf", &nGrid, &minAltDeg, &maxAltDeg) != 3
      || nGrid < 10 || nGrid > 20000)
    return 1;
  if (std::scanf("%lf %lf %lf %lf %lf %d", &dAz, &dAlt, &coneAs, &perpAs, &idxAs, &n) != 6
      || n < 4 || n > 9)
    return 1;
  std::vector<StarIn> stars;
  if (!readStars(n, false, stars))
    return 1;

  CoordConv built;
  built.setPoleError(lat, dAz * DEG, dAlt * DEG, 0.0);
  HeadModel head(coneAs * ARCSEC, perpAs * ARCSEC, idxAs * ARCSEC);
  CoordConv cc;
  std::vector<double> a1(n), a2(n);
  for (int i = 0; i < n; i++) {
    double azS, alt;
    eqToSky(stars[i].ha, stars[i].dec, lat, azS, alt);
    axesOf(built.T, head, azS, alt, stars[i].flip, a1[i], a2[i]);
    stars[i].dha = stars[i].ha;
    stars[i].ddec = stars[i].dec;
    feed(cc, azS, alt, a1[i], a2[i]);
  }
  if (!cc.fitRigidModel()) {
    std::printf("ok 0\n");
    return 0;
  }
  printFit(cc, lat, stars, a1, a2);

  const double z0 = sin(minAltDeg * DEG);
  const double z1 = sin(maxAltDeg * DEG);
  const double golden = M_PI * (3.0 - sqrt(5.0));
  double sumSq = 0.0, worst = 0.0;
  int used = 0;
  for (int i = 0; i < nGrid; i++) {
    const double z = z0 + (z1 - z0) * ((i + 0.5) / nGrid);
    const double alt = asin(z > 1.0 ? 1.0 : (z < -1.0 ? -1.0 : z));
    const double azN = fmod((i * golden), 2.0 * M_PI);
    Coord_HO ho(0.0, alt, azN, false);
    const double azS = ho.direct_Az_S();
    Coord_EQ eq = ho.To_Coord_EQ(lat);
    if (fabs(eq.Dec()) > 80.0 * DEG)
      continue;
    const bool flip = eq.Ha() < 0.0;
    double tax1, tax2;
    axesOf(built.T, head, azS, alt, flip, tax1, tax2);
    double sep, ew, ns;
    residual(cc, azS, alt, tax1, tax2, sep, ew, ns);
    if (!(sep >= 0.0) || sep != sep)
      continue;
    sumSq += sep * sep;
    if (sep > worst)
      worst = sep;
    used++;
  }
  const double rms = used > 0 ? sqrt(sumSq / used) : 0.0;
  std::printf("grid_n %d\n", used);
  std::printf("grid_rms %.6f\n", rms / ARCSEC);
  std::printf("grid_max %.6f\n", worst / ARCSEC);
  return 0;
}

static int cmdDials(double lat)
{
  double dAz, dAlt, chDeg, npDeg, idDeg;
  int n = 0;
  if (std::scanf("%lf %lf %lf %lf %lf %d", &dAz, &dAlt, &chDeg, &npDeg, &idDeg, &n) != 6
      || n < 1 || n > 12)
    return 1;
  // Cone, perpendicularity and the declination index in the hour-angle frame.
  // Pole altitude and azimuth are then applied as the same small-angle tilt
  // Wallace uses, so the envelope measures where the exact head rotations
  // leave that tilt.
  HeadModel head(chDeg * DEG, npDeg * DEG, idDeg * DEG);
  const double latR = lat;
  std::printf("ok 1\n");
  std::printf("dials %d\n", n);
  for (int i = 0; i < n; i++) {
    double ha, dec;
    int flip = 0;
    if (std::scanf("%lf %lf %d", &ha, &dec, &flip) != 3)
      return 1;
    double a1, a2, oha, odec;
    equatorialAxes(ha * DEG, dec * DEG, flip != 0, head, a1, a2);
    equatorialDials(a1, a2, oha, odec);
    const double tn = tan(odec);
    const double sh = sin(oha), ch = cos(oha);
    oha += -dAlt * DEG * sh * tn - dAz * DEG * (sin(latR) - cos(latR) * tn * ch);
    odec += -dAlt * DEG * ch - dAz * DEG * cos(latR) * sh;
    std::printf("%.10f %.10f\n", oha / DEG, odec / DEG);
  }
  return 0;
}

// Mount observations, one per line: RA degrees, Dec degrees, LST hours,
// axis1 degrees (:GXP1#, the Coord_IN hour argument), axis2 degrees (:GXP2#).
// Sky is the geometric place of that target, which is what :A*# stores.
// Axis1_direct stored by the firmware is the negation of the :GXP1# angle.
static int cmdRaw(double lat)
{
  int n = 0;
  if (std::scanf("%d", &n) != 1 || n < 2 || n > 9)
    return 1;
  struct Obs { double ra, dec, lst, a1, a2; };
  std::vector<Obs> obs;
  for (int i = 0; i < n; i++) {
    Obs o;
    if (std::scanf("%lf %lf %lf %lf %lf", &o.ra, &o.dec, &o.lst, &o.a1, &o.a2) != 5)
      return 1;
    obs.push_back(o);
  }

  const LA3::RefrOpt off = { false, 0.0, 0.0 };
  auto feed = [&](CoordConv &cc, bool progressive) {
    for (int i = 0; i < n; i++) {
      const double haDeg = std::remainder(obs[i].lst * 15.0 - obs[i].ra, 360.0);
      Coord_EQ eq(0.0, obs[i].dec * DEG, haDeg * DEG);
      Coord_HO ho = eq.To_Coord_HO(lat, off);
      const double ax1 = -obs[i].a1 * DEG;
      const double ax2 = obs[i].a2 * DEG;
      cc.addStar(ho.direct_Az_S(), ho.Alt(), ax1, ax2);
      if (i < 2)
        cc.addReference(ho.direct_Az_S(), ho.Alt(), ax1, ax2);
      std::printf("star %d az %+.4f alt %+.4f ax1 %+.4f ax2 %+.4f\n",
                  i + 1, ho.direct_Az_S() / DEG, ho.Alt() / DEG,
                  ax1 / DEG, ax2 / DEG);
      if (progressive && i >= 2 && i < n - 1 && cc.fitProgressive(0, 0, off)) {
        float c, p, ix;
        cc.getHead(c, p, ix);
        std::printf("  after %d  CH %+.2f  NP %+.2f  ID %+.2f  ME %+.3f'  MA %+.3f'\n",
                    i + 1, c / ARCSEC, -p / ARCSEC, ix / ARCSEC,
                    -cc.polErrorDeg(lat, PE_EQ_ALT) * 60.0,
                    cc.polErrorDeg(lat, PE_EQ_AZ) * std::cos(lat) * 60.0);
      }
    }
  };
  auto report = [&](const char *tag, CoordConv &cc) {
    if (!cc.isReady() || !cc.fitRigidModel(0, 0, off)) {
      std::printf("%s ok 0\n", tag);
      return;
    }
    float c, p, ix;
    cc.getHead(c, p, ix);
    std::printf("%s CH %+.3f NP %+.3f ID %+.3f ME %+.4f MA %+.4f W %+.4f RMS %.3f mask %u\n",
                tag, c / ARCSEC, -p / ARCSEC, ix / ARCSEC,
                -cc.polErrorDeg(lat, PE_EQ_ALT) * 60.0,
                cc.polErrorDeg(lat, PE_EQ_AZ) * std::cos(lat) * 60.0,
                cc.polErrorDeg(lat, PE_POL_W) * 60.0,
                cc.getRigidRms() / ARCSEC, (unsigned)cc.getRigidMask());
  };

  CoordConv batch;
  feed(batch, false);
  if (batch.isReady()) {
    std::printf("seed ME %+.4f' MA %+.4f' W %+.4f'\n",
                -batch.polErrorDeg(lat, PE_EQ_ALT) * 60.0,
                batch.polErrorDeg(lat, PE_EQ_AZ) * std::cos(lat) * 60.0,
                batch.polErrorDeg(lat, PE_POL_W) * 60.0);
  }
  report("batch", batch);

  CoordConv session;
  feed(session, true);
  report("session", session);
  return 0;
}

// Retained observations from :GXAo — degrees: az_S, alt, axis1Direct, axis2.
struct StoredObs {
  double az, alt, ax1, ax2;
};

static bool readStored(int n, std::vector<StoredObs> &obs)
{
  obs.clear();
  for (int i = 0; i < n; i++) {
    StoredObs o;
    if (std::scanf("%lf %lf %lf %lf", &o.az, &o.alt, &o.ax1, &o.ax2) != 4)
      return false;
    obs.push_back(o);
  }
  return true;
}

static void reportStored(const char *tag, const CoordConv &cc, double lat)
{
  float c = 0, p = 0, ix = 0;
  cc.getHead(c, p, ix);
  const double me = -cc.polErrorDeg(lat, PE_EQ_ALT);
  const double ma = cc.polErrorDeg(lat, PE_EQ_AZ) * std::cos(lat);
  const double w = cc.polErrorDeg(lat, PE_POL_W);
  const double rms = cc.getRigidRms() > 0.0 ? cc.getRigidRms() : 0.0;
  std::printf("%s ok 1\n", tag);
  std::printf("%s CH %.6f\n", tag, c / ARCSEC);
  std::printf("%s NP %.6f\n", tag, -p / ARCSEC);
  std::printf("%s ID %.6f\n", tag, ix / ARCSEC);
  std::printf("%s ME %.8f\n", tag, me);
  std::printf("%s MA %.8f\n", tag, ma);
  std::printf("%s W %.8f\n", tag, w);
  std::printf("%s RMS %.6f\n", tag, rms / ARCSEC);
  std::printf("%s mask %u\n", tag, (unsigned)cc.getRigidMask());
  if (rms <= 0.0)
    std::printf("%s residual %.6f\n", tag, cc.residualRms() / ARCSEC);
}

// Exact two-star close-out: Taki seed then minimizeAxis1/2 (GEM north offset).
static int cmdTwostar(double lat)
{
  int n = 0;
  if (std::scanf("%d", &n) != 1 || n != 2)
    return 1;
  std::vector<StoredObs> obs;
  if (!readStored(n, obs))
    return 1;
  CoordConv cc;
  for (int i = 0; i < n; i++) {
    const double az = obs[i].az * DEG;
    const double alt = obs[i].alt * DEG;
    const double a1 = obs[i].ax1 * DEG;
    const double a2 = obs[i].ax2 * DEG;
    cc.addStar(az, alt, a1, a2);
    cc.addReference(az, alt, a1, a2);
  }
  if (!cc.isReady()) {
    std::printf("twostar ok 0\n");
    return 0;
  }
  cc.minimizeAxis2();
  cc.minimizeAxis1(lat >= 0.0 ? M_PI_2 : -M_PI_2);
  // The mount leaves :GXAr# at 0 after a two-star close-out; reportStored
  // uses getRigidRms() which is also 0 here.
  reportStored("twostar", cc, lat);
  return 0;
}

// Replay retained :GXAo stars. Batch = one-shot close-out on the dumped frame.
// Session = progressive refit for goto only (no shift), then the same close-out
// on the frozen accept frame — matching Command_A after the freeze-frame change.
static int cmdStored(double lat)
{
  int n = 0;
  if (std::scanf("%d", &n) != 1 || n < 3 || n > 9)
    return 1;
  std::vector<StoredObs> obs;
  if (!readStored(n, obs))
    return 1;

  auto feedOne = [](CoordConv &cc, const StoredObs &o) {
    const double az = o.az * DEG;
    const double alt = o.alt * DEG;
    const double a1 = o.ax1 * DEG;
    const double a2 = o.ax2 * DEG;
    const bool seed = cc.getStars() < 2;
    cc.addStar(az, alt, a1, a2);
    if (seed)
      cc.addReference(az, alt, a1, a2);
  };

  auto closeOut = [&](CoordConv &cc) -> bool {
    if (!cc.isReady())
      return false;
    double rms = 0;
    if (n >= 4)
      return cc.fitRigidModel(&rms, 0, NO_REFR) && cc.hasHead();
    return cc.fitProgressive(&rms, 0, NO_REFR) && cc.hasHead();
  };

  CoordConv batch;
  for (int i = 0; i < n; i++)
    feedOne(batch, obs[i]);
  if (!closeOut(batch)) {
    batch.minimizeAxis2();
    batch.minimizeAxis1(lat >= 0.0 ? M_PI_2 : -M_PI_2);
  }
  reportStored("batch", batch, lat);

  CoordConv session;
  for (int i = 0; i < n; i++) {
    feedOne(session, obs[i]);
    if (i >= 2 && i < n - 1)
      session.fitProgressive(0, 0, NO_REFR);
  }
  if (!closeOut(session)) {
    session.minimizeAxis2();
    session.minimizeAxis1(lat >= 0.0 ? M_PI_2 : -M_PI_2);
  }
  reportStored("session", session, lat);
  return 0;
}

// Given T (row-major), head (arcsec, Wallace NP already negated to perp), and
// instrument axes (degrees, Axis1_direct / Axis2), print sky HA and Dec in degrees.
static int cmdInstrSky(double lat)
{
  double Tm[9];
  double coneAs = 0, perpAs = 0, idxAs = 0, a1d = 0, a2 = 0;
  if (std::scanf("%lf %lf %lf %lf %lf %lf %lf %lf %lf",
                 &Tm[0], &Tm[1], &Tm[2], &Tm[3], &Tm[4], &Tm[5],
                 &Tm[6], &Tm[7], &Tm[8]) != 9)
    return 1;
  if (std::scanf("%lf %lf %lf %lf %lf", &coneAs, &perpAs, &idxAs, &a1d, &a2) != 5)
    return 1;
  CoordConv cc;
  cc.setT((float)Tm[0], (float)Tm[1], (float)Tm[2],
          (float)Tm[3], (float)Tm[4], (float)Tm[5],
          (float)Tm[6], (float)Tm[7], (float)Tm[8]);
  cc.setTinvFromT();
  cc.setHead(coneAs * ARCSEC, perpAs * ARCSEC, idxAs * ARCSEC);
  Coord_IN in(0.0, a2 * DEG, -a1d * DEG); // Axis1 = -Axis1_direct
  Coord_EQ eq = in.To_Coord_EQ(cc.T, NO_REFR, lat, cc.head);
  std::printf("ok 1\n");
  std::printf("ha %.10f\n", eq.Ha() / DEG);
  std::printf("dec %.10f\n", eq.Dec() / DEG);
  return 0;
}

// Wallace ME/MA (radians) → setPoleError (dAz, dAlt) in the plumbed frame.
// MA = dAz * cos(lat); ME = -dAlt (positive ME = dial pole below the true pole).
static void wallaceToPoleTilt(double lat, double me, double ma, double &dAz, double &dAlt)
{
  const double c = cos(lat);
  dAz = (fabs(c) > 1e-8) ? (ma / c) : 0.0;
  dAlt = -me;
}

// ME/MA as plumbed polar tilts on T; CH/NP/ID as HeadGeom. Fit in HO, then true
// RMS on an equal-area Alt/Az grid generated from the same truth. This is the
// transfer Wallace uses when the mount is plumbed — not the tan/sec MA operator.
static int cmdPlumbedGrid(double lat)
{
  int nGrid = 0, n = 0;
  double minAltDeg = 15.0, maxAltDeg = 85.0;
  double meAm = 0, maAm = 0, chAm = 0, npAm = 0, idAm = 0;
  if (std::scanf("%d %lf %lf", &nGrid, &minAltDeg, &maxAltDeg) != 3
      || nGrid < 10 || nGrid > 20000)
    return 1;
  if (std::scanf("%lf %lf %lf %lf %lf", &meAm, &maAm, &chAm, &npAm, &idAm) != 5)
    return 1;
  if (std::scanf("%d", &n) != 1 || n < 4 || n > 9)
    return 1;
  std::vector<StarIn> stars;
  if (!readStars(n, false, stars))
    return 1;

  double dAz = 0, dAlt = 0;
  wallaceToPoleTilt(lat, meAm * 60.0 * ARCSEC, maAm * 60.0 * ARCSEC, dAz, dAlt);
  CoordConv built;
  built.setPoleError(lat, dAz, dAlt, 0.0);
  // Wallace NP = -perp.
  HeadModel head(chAm * 60.0 * ARCSEC, -npAm * 60.0 * ARCSEC, idAm * 60.0 * ARCSEC);

  CoordConv cc;
  std::vector<double> a1(n), a2(n);
  for (int i = 0; i < n; i++) {
    double azS, alt;
    eqToSky(stars[i].ha, stars[i].dec, lat, azS, alt);
    axesOf(built.T, head, azS, alt, stars[i].flip, a1[i], a2[i]);
    stars[i].dha = stars[i].ha;
    stars[i].ddec = stars[i].dec;
    feed(cc, azS, alt, a1[i], a2[i]);
  }
  if (!cc.fitRigidModel()) {
    std::printf("ok 0\n");
    return 0;
  }
  printFit(cc, lat, stars, a1, a2);

  const double z0 = sin(minAltDeg * DEG);
  const double z1 = sin(maxAltDeg * DEG);
  const double golden = M_PI * (3.0 - sqrt(5.0));
  double sumSq = 0.0, worst = 0.0;
  int used = 0;
  for (int i = 0; i < nGrid; i++) {
    const double z = z0 + (z1 - z0) * ((i + 0.5) / nGrid);
    const double alt = asin(z > 1.0 ? 1.0 : (z < -1.0 ? -1.0 : z));
    const double azN = fmod((i * golden), 2.0 * M_PI);
    Coord_HO ho(0.0, alt, azN, false);
    const double azS = ho.direct_Az_S();
    Coord_EQ eq = ho.To_Coord_EQ(lat);
    if (fabs(eq.Dec()) > 80.0 * DEG)
      continue;
    const bool flip = eq.Ha() < 0.0;
    double tax1, tax2;
    axesOf(built.T, head, azS, alt, flip, tax1, tax2);
    double sep, ew, ns;
    residual(cc, azS, alt, tax1, tax2, sep, ew, ns);
    if (!(sep >= 0.0) || sep != sep)
      continue;
    sumSq += sep * sep;
    if (sep > worst)
      worst = sep;
    used++;
  }
  const double rms = used > 0 ? sqrt(sumSq / used) : 0.0;
  std::printf("grid_n %d\n", used);
  std::printf("grid_rms %.6f\n", rms / ARCSEC);
  std::printf("grid_max %.6f\n", worst / ARCSEC);
  // Wallace-facing export of the recovered pole (plumbed frame).
  std::printf("export_ME %.6f\n", -cc.polErrorDeg(lat, PE_EQ_ALT) * 3600.0);
  std::printf("export_MA %.6f\n", cc.polErrorDeg(lat, PE_EQ_AZ) * cos(lat) * 3600.0);
  return 0;
}

// Park encoders on plumbed ME/MA + HeadGeom CH/NP/ID dials under the live T+head.
static int cmdPlumbedGoto(double lat)
{
  double lstH = 0;
  double Tm[9];
  double liveCh = 0, liveNp = 0, liveId = 0;
  double tha = 0, tdec = 0;
  int flip = 0;
  double meAm = 0, maAm = 0, chAm = 0, npAm = 0, idAm = 0;
  if (std::scanf("%lf", &lstH) != 1)
    return 1;
  if (std::scanf("%lf %lf %lf %lf %lf %lf %lf %lf %lf",
                 &Tm[0], &Tm[1], &Tm[2], &Tm[3], &Tm[4], &Tm[5],
                 &Tm[6], &Tm[7], &Tm[8]) != 9)
    return 1;
  if (std::scanf("%lf %lf %lf %lf %lf %d", &liveCh, &liveNp, &liveId, &tha, &tdec, &flip) != 6)
    return 1;
  if (std::scanf("%lf %lf %lf %lf %lf", &meAm, &maAm, &chAm, &npAm, &idAm) != 5)
    return 1;

  double dAz = 0, dAlt = 0;
  wallaceToPoleTilt(lat, meAm * 60.0 * ARCSEC, maAm * 60.0 * ARCSEC, dAz, dAlt);
  CoordConv truth;
  truth.setPoleError(lat, dAz, dAlt, 0.0);
  HeadModel truthHead(chAm * 60.0 * ARCSEC, -npAm * 60.0 * ARCSEC, idAm * 60.0 * ARCSEC);

  double azS, alt;
  eqToSky(tha * DEG, tdec * DEG, lat, azS, alt);
  double a1 = 0, a2 = 0;
  axesOf(truth.T, truthHead, azS, alt, flip != 0, a1, a2);

  CoordConv live;
  live.setT((float)Tm[0], (float)Tm[1], (float)Tm[2],
            (float)Tm[3], (float)Tm[4], (float)Tm[5],
            (float)Tm[6], (float)Tm[7], (float)Tm[8]);
  live.setTinvFromT();
  live.setHead(liveCh * ARCSEC, -liveNp * ARCSEC, liveId * ARCSEC);
  Coord_IN in(0.0, a2, -a1);
  Coord_EQ eq = in.To_Coord_EQ(live.T, NO_REFR, lat, live.head);
  const double haDeg = eq.Ha() / DEG;
  const double decDeg = eq.Dec() / DEG;
  double raDeg = lstH * 15.0 - haDeg;
  while (raDeg < 0.0) raDeg += 360.0;
  while (raDeg >= 360.0) raDeg -= 360.0;
  std::printf("ok 1\n");
  std::printf("ra %.10f\n", raDeg);
  std::printf("dec %.10f\n", decDeg);
  std::printf("ha %.10f\n", haDeg);
  std::printf("a1 %.10f\n", a1 / DEG);
  std::printf("a2 %.10f\n", a2 / DEG);
  return 0;
}

// Build the sky RA/Dec that lands the mount on Wallace tan/sec dials under the
// current T+head. Kept for legacy formula comparisons; prefer plumbedgoto for
// ME/MA that match TeenAstro's plumbed pole export.
static int cmdWalGoto(double lat)
{
  double lstH = 0;
  double Tm[9];
  double chAs = 0, npAs = 0, idAs = 0;
  double tha = 0, tdec = 0;
  int flip = 0;
  double meAm = 0, maAm = 0, chAm = 0, npAm = 0, idAm = 0;
  if (std::scanf("%lf", &lstH) != 1)
    return 1;
  if (std::scanf("%lf %lf %lf %lf %lf %lf %lf %lf %lf",
                 &Tm[0], &Tm[1], &Tm[2], &Tm[3], &Tm[4], &Tm[5],
                 &Tm[6], &Tm[7], &Tm[8]) != 9)
    return 1;
  if (std::scanf("%lf %lf %lf %lf %lf %d", &chAs, &npAs, &idAs, &tha, &tdec, &flip) != 6)
    return 1;
  if (std::scanf("%lf %lf %lf %lf %lf", &meAm, &maAm, &chAm, &npAm, &idAm) != 5)
    return 1;

  // Wallace dial HA/Dec (same side flip as the harness).
  const double side = flip ? -1.0 : 1.0;
  const double me = meAm * 60.0 * ARCSEC;
  const double ma = maAm * 60.0 * ARCSEC;
  const double ch = chAm * 60.0 * ARCSEC * side;
  const double np = npAm * 60.0 * ARCSEC * side;
  const double id = idAm * 60.0 * ARCSEC * side;
  double mha = tha * DEG, mdec = tdec * DEG;
  for (int round = 0; round < 16; round++) {
    const double sec = 1.0 / cos(mdec);
    const double tn = tan(mdec);
    const double dh = ch * sec + np * tn + ma * cos(mha) * tn - me * sin(mha) * tn;
    const double dd = id - me * cos(mha) + ma * sin(mha);
    mha = tha * DEG - dh;
    mdec = tdec * DEG - dd;
  }

  // GEM instrument angles (same as EEPROM synthetic seed / getInstr):
  // east: Axis1 = HA - 90°, Axis2 = Dec; west: Axis1 = HA + 90°, Axis2 = 180° - Dec.
  const double axis1 = flip ? (mha + M_PI_2) : (mha - M_PI_2);
  const double axis2 = flip ? (M_PI - mdec) : mdec;

  CoordConv cc;
  cc.setT((float)Tm[0], (float)Tm[1], (float)Tm[2],
          (float)Tm[3], (float)Tm[4], (float)Tm[5],
          (float)Tm[6], (float)Tm[7], (float)Tm[8]);
  cc.setTinvFromT();
  // Command reports NP = -perp; convert Wallace NP arcsec to internal perp.
  cc.setHead(chAs * ARCSEC, -npAs * ARCSEC, idAs * ARCSEC);
  Coord_IN in(0.0, axis2, axis1);
  Coord_EQ eq = in.To_Coord_EQ(cc.T, NO_REFR, lat, cc.head);
  const double haDeg = eq.Ha() / DEG;
  const double decDeg = eq.Dec() / DEG;
  double raDeg = lstH * 15.0 - haDeg;
  while (raDeg < 0.0) raDeg += 360.0;
  while (raDeg >= 360.0) raDeg -= 360.0;
  std::printf("ok 1\n");
  std::printf("ra %.10f\n", raDeg);
  std::printf("dec %.10f\n", decDeg);
  std::printf("ha %.10f\n", haDeg);
  std::printf("a1 %.10f\n", (-axis1) / DEG); // Axis1_direct
  std::printf("a2 %.10f\n", axis2 / DEG);
  return 0;
}

int main()
{
  char cmd[32];
  if (std::scanf("%31s", cmd) != 1)
    return 1;
  double latDeg = 48.0;
  if (std::scanf("%lf", &latDeg) != 1)
    return 1;
  const double lat = latDeg * DEG;
  if (std::strcmp(cmd, "fit") == 0)
    return cmdFit(lat);
  if (std::strcmp(cmd, "gridrms") == 0)
    return cmdGridRms(lat);
  if (std::strcmp(cmd, "session") == 0)
    return cmdSession(lat);
  if (std::strcmp(cmd, "self") == 0)
    return cmdSelf(lat);
  if (std::strcmp(cmd, "selfgrid") == 0)
    return cmdSelfGrid(lat);
  if (std::strcmp(cmd, "plumbedgrid") == 0)
    return cmdPlumbedGrid(lat);
  if (std::strcmp(cmd, "plumbedgoto") == 0)
    return cmdPlumbedGoto(lat);
  if (std::strcmp(cmd, "dials") == 0)
    return cmdDials(lat);
  if (std::strcmp(cmd, "raw") == 0)
    return cmdRaw(lat);
  if (std::strcmp(cmd, "twostar") == 0)
    return cmdTwostar(lat);
  if (std::strcmp(cmd, "stored") == 0)
    return cmdStored(lat);
  if (std::strcmp(cmd, "instrsky") == 0)
    return cmdInstrSky(lat);
  if (std::strcmp(cmd, "walgoto") == 0)
    return cmdWalGoto(lat);
  std::fprintf(stderr, "unknown command %s\n", cmd);
  return 1;
}
